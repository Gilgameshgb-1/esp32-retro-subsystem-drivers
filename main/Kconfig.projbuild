## main/Kconfig.projbuild
```kconfig
menu "Display Driver Wi-Fi"

    config WIFI_SSID
        string "Wi-Fi SSID"
        default "myssid"

    config WIFI_PASSWORD
        string "Wi-Fi Password"
        default "mypassword"

endmenu
```

## sdkconfig.defaults
```kconfig
CONFIG_BLINK_LED_GPIO=y
CONFIG_BLINK_GPIO=8
CONFIG_WIFI_SSID="XXXXX"
CONFIG_WIFI_PASSWORD="XXXXX"
CONFIG_PARTITION_TABLE_CUSTOM=y
CONFIG_PARTITION_TABLE_CUSTOM_FILENAME="partitions.csv"
CONFIG_PARTITION_TABLE_OFFSET=0x8000
CONFIG_ESPTOOLPY_FLASHSIZE_4MB=y
CONFIG_ESPTOOLPY_FLASHSIZE="4MB"
```
